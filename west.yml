## west.yml
```yaml
manifest:
  remotes:
    - name: JsmnRepo
      url-base: https://github.com/zserge
    - name: LairdCP
      url-base: https://github.com/LairdCP
    - name: ncs
      url-base: https://github.com/nrfconnect

  # Please add items below based on alphabetical order.
  # These dependencies may need updating if new features are added to the firmware.
  projects:
    - name: zephyr_framework
      path: modules/framework
      revision: ab025edc9245cedfd82c90d3054f168dd9f1f1cb
      remote: LairdCP
    - name: jsmn
      path: modules/jsmn
      revision: 7b6858a5855299d173c5ab2b46e611bf9961cbef
      remote: JsmnRepo
    - name: memfault-firmware-sdk
      path: modules/memfault-firmware-sdk
      revision: 3bb88f31fc953f3f13ac4461fe413ff6ff2288a5
      remote: LairdCP     
    - name: Pinnacle-100-firmware
      path: pinnacle_100_firmware
      revision: c7cd9fbf0f0fe1af96932b4aa72c87ec4738b12a
      remote: LairdCP
    - name: sdk-nrf
      path: nrf
      revision: v1.4.0
      remote: ncs
      import: true
    - name: zephyr
      west-commands: scripts/west-commands.yml
      revision: c49ee01f7390061d69d3d342089c28c90536a2e9
      remote: LairdCP
      import: true
    - name: zephyr_boards
      path: pinnacle_100_firmware/boards/arm
      revision: f12ea491dc15ea927bdd5a83d30049aea4811b27
      remote: LairdCP
    - name: zephyr_lib
      path: modules/zephyr_lib
      revision: b5d9a1983261aca7a50eb659d757aa12529bcda8
      remote: LairdCP

  self:
    path: pinnacle_100_firmware_public_manifest
```
